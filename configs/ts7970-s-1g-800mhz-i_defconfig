## configs/ts7970-s-1g-800mhz-i_defconfig
```kconfig
CONFIG_SYS_EXTRA_OPTIONS="IMX_CONFIG=board/technologic/ts7970/ts7970-s-1g-800mhz-i.cfg,MX6DL,DDR_MB=1024,IMX_TYPE=\"ts7970-s-1g-800mhz-i\""
CONFIG_ARM=y
CONFIG_TARGET_TS7970=y
CONFIG_DM=y
CONFIG_DM_THERMAL=y

CONFIG_ENV_OFFSET_REDUND=0x180000
CONFIG_SYS_REDUNDAND_ENVIRONMENT=y

CONFIG_BOOTCOUNT_LIMIT=y
CONFIG_BOOTCOUNT_ENV=y
```
